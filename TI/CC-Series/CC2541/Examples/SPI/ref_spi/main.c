/************************************************************************************************************************************/
/** @file       main.c
 *  @brief      x
 *  @details	x
 *
 *  @target     Texas Instruments CC2541F128
 *  @board      all
 *
 *  @author     Justin Reina, Firmware Engineer
 *  @created	6/22/17
 *  @last rev	6/22/17
 *
 *  @section    CC2541EMK Pinouts (using TrxEB)
 *      MOSI - P0.3     (P1.9)  / (TrxEB7.7)
 *      MISO - P0.2     (P1.7)  / (TrxEB7.9)
 *      SCLK - P0.5     (P2.18) / (TrxEB7.3)
 *      CS_N - P0.4     (P1.3)  / (TrxEB7.5)
 *      RST  - P1.2     (P2.17) / (TrxEB7.11)
 *      
 *  @section    CC1175EMK Pinouts (using TrxEB)
 *      MOSI - MOSI     (P1.18) / (TrxEB-7.16)      Purple
 *      MISO - MISO     (P1.20) / (TrxEB-7.18)      Yellow
 *      SCLK - SCLK     (P1.16) / (TrxEB-7.12)      Green
 *      CS_N - CSN      (P1.14) / (TrxEB-7.14)      Blue
 *      RST  - RESET    (P1.15) / (TrxEB-7.10)      Grey
 *
 *  @section	Legal Disclaimer
 *      All contents of this source file and/or any other related source files are the explicit property of Justin Reina. Do not 
 *      distribute. Do not copy.
 */
/************************************************************************************************************************************/
#include "globals.h"

    //Locals
    uint16_t i = 0;
    uint8_t rx_val = 0x00;


/************************************************************************************************************************************/
/** @fcn        int main(void)
 *  @brief      x
 *  @details    x
 */
/************************************************************************************************************************************/
int main(void) {

    //Init
     sys_init();

    //PARTNUMBER
    for(;;) {
        //CS LOW
        P1 &= ~BIT7;
        RADIO_PORT &= ~RADIO_PIN_CS_N;
        
        //0xEF
        spi_transmit(0xEF);                                                 /* 0xEF = b7+ (b7 | b6 | 0x2F)                          */
        
        //0x8F
        spi_transmit(0x8F);                                                 /* 0x8F = Extended Address                              */
        
        //0x00
        spi_transmit(0x00);                                                 /* D.C.                                                 */
        rx_val = U0DBUF;                                                    /* grab the part number response                        */
        
        //CS HIGH
        RADIO_PORT |= RADIO_PIN_CS_N;
        P1 |= BIT7;
        
        asm(" NOP");                                                        /* for debug breakpoints                                */
        
        //Small Delay
        for(i=0; i<50000; i++) {
            asm(" NOP");                                                    /* set to 20 kHz                                        */
        }
    }
}


/************************************************************************************************************************************/
/** @fcn        void sys_init(void)
 *  @brief      init system on boot
 *  @details    x
 */
/************************************************************************************************************************************/
void sys_init(void) {


    //******************************************************************************************************************************//
    //                                                      CLOCK                                                                   //
    //******************************************************************************************************************************//
    CLKCONCMD = (CLKCONCMD & ~(CLKCON_OSC | CLKCON_CLKSPD)) | CLKCON_CLKSPD_32M;        // Set to HS XOSC, no pre-scaling           */
    while (CLKCONSTA & CLKCON_OSC);                                         /* Wait until clock source has changed                  */

    
    //******************************************************************************************************************************//
    //                                                       I/O                                                                    //
    //******************************************************************************************************************************//
    spi_gpio_init();

    P1DIR |= BIT7;                                                          /* Debug Pin                                            */
    P1 |= BIT7;
    

    //******************************************************************************************************************************//
    //                                                       SPI                                                                    //
    //******************************************************************************************************************************//
    spi_init();


    //******************************************************************************************************************************//
    //                                                       RADIO                                                                  //
    //******************************************************************************************************************************//

    
    
    return;
}


/************************************************************************************************************************************/
/** @fcn        void std_delay(void)
 *  @brief      a small unquantified delay
 *  @details    x
 */
/************************************************************************************************************************************/
void std_delay(void) {
  
  volatile uint16_t i = 0;
  
  for(i=0; i<5; i++) {
    asm(" NOP");
  }
  
  return;
}
 
